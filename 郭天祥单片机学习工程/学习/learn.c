                    /*12Mhz������*/
#include <reg52.h>
#define uint unsigned int
#define uchar unsigned char
sbit voice=P1^5;
uchar code sound[]={0x49,0x44,0x33,0x03,0x00,0x00,0x00,0x05,0x29,0x2B,0x54,0x49,0x54,0x32,0x00,0x00,

0x00,0x09,0x00,0x00,0x01,0xFF,0xFE,0xA3,0x90,0x00,0x4E,0x1C,0x59,0x54,0x50,0x45,

0x31,0x00,0x00,0x00,0x07,0x00,0x00,0x01,0xFF,0xFE,0x22,0x8C,0x9B,0x51,0x54,0x41,

0x4C,0x42,0x00,0x00,0x00,0x09,0x00,0x00,0x01,0xFF,0xFE,0xA3,0x90,0x00,0x4E,0x1C,

0x59,0x54,0x58,0x58,0x58,0x00,0x00,0x00,0x1F,0x00,0x00,0x01,0xFF,0xFE,0x49,0x00,
                   };
uchar zdjs=0, jp;
del(yj);
void main(void)
  {
      uint dpjs=0;
      uchar yj;
      TMOD=0x01,IE=0x82;
      TH0=0xd8, TL0=0xef;
   TR0=1;
while(1)
   {  
      zdjs=0;
      dpjs++; yj=sound[dpjs]; 
     dpjs++; jp=sound[dpjs];
   while(zdjs!=jp)
       { 
      if(yj!=0xff)
   {
             if(yj!=0)
               {
             voice=!voice;
                 del(yj);
                }
                else
          {
          dpjs=0; 
                      break;
                     }
    }
    else
      {
        voice=0;
                 del(jp);
    }
      }
       }
   }
time0() interrupt 1  using 1
      {
         TH0=0xd8, TL0=0xef;
         zdjs++;
           }
del(yj)
    {
      uchar yj2=2;
       while(yj!=0)
         {      
               while(yj2!=0)
                  {
                     yj2--;
                     }
                  yj2=2;
             yj--;  
       }
   
     }